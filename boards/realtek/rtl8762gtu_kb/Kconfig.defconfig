## boards/realtek/rtl8762gtu_kb/Kconfig.defconfig
```kconfig
if BOARD_RTL8762GTU

config BOARD
    default "rtl8762gtu"

endif #BOARD_RTL8762GTU
```

## config/west.yml
```yaml
manifest:
  version: "0.13"
  remotes:
    - name: keychron
      url-base: https://github.com/Keychron
  projects:
    - name: zephyr
      remote: keychron
      # rtl87x2g 리비전 제거 - 기본 브랜치 사용
      clone-depth: 1
      import:
        name-blocklist:
          # CI and tooling
          - ci-tools
          # HALs - 불필요한 하드웨어 지원 제거
          - hal_altera
          - hal_cypress
          - hal_infineon
          - hal_microchip
          - hal_nxp
          - hal_openisa
          - hal_silabs
          - hal_xtensa
          - hal_st
          - hal_ti
          - hal_ambiq
          - hal_atmel
          - hal_espressif
          - hal_ethos_u
          - hal_gigadevice
          - hal_intel
          - hal_nordic
          - hal_nuvoton
          - hal_quicklogic
          - hal_renesas
          - hal_rpi_pico
          - hal_telink
          - hal_wurthelektronik
          - hal_stm32
          # 불필요한 라이브러리
          - cmsis-dsp
          - cmsis-nn
          - fatfs
          - loramac-node
          - mcuboot
          - mcumgr
          - net-tools
          - openthread
          - edtt
          - trusted-firmware-m
  self:
    path: config
    # west 확장 명령어 (필요시 추가)
    # west-commands: scripts/west-commands.yml
```
